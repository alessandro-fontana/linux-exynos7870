## Documentation/devicetree/bindings/leds/siliconmitus,sm5703-flash.yaml
```yaml
# SPDX-License-Identifier: (GPL-2.0-only OR BSD-2-Clause)
%YAML 1.2
---
$id: http://devicetree.org/schemas/leds/siliconmitus,sm5703-flash.yaml#
$schema: http://devicetree.org/meta-schemas/core.yaml#

title: Silicon Mitus SM5703 flash LED driver

maintainers:
  - Alessandro Fontana <alessandro.fontana@pm.me>

description: |
  The SM5703 drives one flash LED from the output of its boost converter,
  in torch (movie) or flash mode.  It is a function of the SM5703 PMIC and
  is described as a child node of it, see
  ../mfd/siliconmitus,sm5703.yaml.

properties:
  compatible:
    const: siliconmitus,sm5703-flash

  led:
    type: object
    $ref: common.yaml#
    unevaluatedProperties: false

    properties:
      led-max-microamp:
        minimum: 10000
        maximum: 320000
        default: 150000

      flash-max-microamp:
        minimum: 300000
        maximum: 1500000
        default: 1200000

      flash-max-timeout-us:
        minimum: 100000
        maximum: 1600000
        default: 1600000

required:
  - compatible
  - led

additionalProperties: false

examples:
  - |
    #include <dt-bindings/leds/common.h>

    flash {
        compatible = "siliconmitus,sm5703-flash";

        led {
            function = LED_FUNCTION_FLASH;
            color = <LED_COLOR_ID_WHITE>;
            led-max-microamp = <150000>;
            flash-max-microamp = <1200000>;
            flash-max-timeout-us = <1600000>;
        };
    };
```

## Documentation/devicetree/bindings/media/i2c/dongwoon,dw9807-vcm.yaml
```yaml
# SPDX-License-Identifier: (GPL-2.0-only OR BSD-2-Clause)
# Copyright (C) 2018, 2021 Intel Corporation
%YAML 1.2
---
$id: http://devicetree.org/schemas/media/i2c/dongwoon,dw9807-vcm.yaml#
$schema: http://devicetree.org/meta-schemas/core.yaml#

title: Dongwoon Anatech DW9807 voice coil lens driver

maintainers:
  - Sakari Ailus <sakari.ailus@linux.intel.com>

description: |
  DW9807 is a 10-bit DAC with current sink capability. It is intended for
  controlling voice coil lenses.

properties:
  compatible:
    const: dongwoon,dw9807-vcm

  reg:
    maxItems: 1

  vdd-supply:
    description: Power supply of the device.

  dongwoon,sac-mode:
    description:
      Enables the ringing control and selects the Smart Actuator Control
      mode, MODE[7:5]; direct mode when absent.
    $ref: /schemas/types.yaml#/definitions/uint32
    maximum: 7

  dongwoon,vcm-prescale:
    description: Prescaler of the SAC period, MODE[2:0].
    $ref: /schemas/types.yaml#/definitions/uint32
    maximum: 7
    default: 0

  dongwoon,sac-timing:
    description: SAC period, 6.3 ms + value * 0.1 ms.
    $ref: /schemas/types.yaml#/definitions/uint32
    maximum: 0x3f
    default: 0x20

required:
  - compatible
  - reg

additionalProperties: false

examples:
  - |
    i2c {
        #address-cells = <1>;
        #size-cells = <0>;

        lens@e {
            compatible = "dongwoon,dw9807-vcm";
            reg = <0x0e>;
        };
    };
...
```

## Documentation/devicetree/bindings/mfd/siliconmitus,sm5703.yaml
```yaml
# SPDX-License-Identifier: (GPL-2.0-only OR BSD-2-Clause)
%YAML 1.2
---
$id: http://devicetree.org/schemas/mfd/siliconmitus,sm5703.yaml#
$schema: http://devicetree.org/meta-schemas/core.yaml#

title: Silicon Mitus SM5703 PMIC

maintainers:
  - Markuss Broks <markuss.broks@gmail.com>

description: |
  The SM5703 combines a charger, LDO and buck regulators, a flash LED
  driver, a MUIC USB switch and a fuel gauge.  The charger, the
  regulators and the LED driver share the I2C address described by this
  binding.  The fuel gauge has an address of its own, usually on a
  different bus, and is described separately by
  siliconmitus,sm5703-fuelgauge.yaml.

properties:
  compatible:
    const: siliconmitus,sm5703

  reg:
    maxItems: 1

  interrupts:
    maxItems: 1

  reset-gpios:
    maxItems: 1
    description: GPIO connected to the MRSTB pin.

  charger:
    $ref: /schemas/power/supply/siliconmitus,sm5703-charger.yaml#
    type: object
    unevaluatedProperties: false

required:
  - compatible
  - reg

additionalProperties: false

examples:
  - |
    #include <dt-bindings/gpio/gpio.h>
    #include <dt-bindings/interrupt-controller/irq.h>

    i2c {
        #address-cells = <1>;
        #size-cells = <0>;

        pmic@49 {
            compatible = "siliconmitus,sm5703";
            reg = <0x49>;

            interrupt-parent = <&gpa2>;
            interrupts = <7 IRQ_TYPE_EDGE_FALLING>;

            reset-gpios = <&gpc7 4 GPIO_ACTIVE_LOW>;

            charger {
                compatible = "siliconmitus,sm5703-charger";
                monitored-battery = <&battery>;
                extcon = <&muic>;
                enable-gpios = <&gpd1 3 GPIO_ACTIVE_LOW>;
                input-current-limit-microamp = <1650000>;
            };
        };
    };
```

## Documentation/devicetree/bindings/power/supply/siliconmitus,sm5703-charger.yaml
```yaml
# SPDX-License-Identifier: (GPL-2.0-only OR BSD-2-Clause)
%YAML 1.2
---
$id: http://devicetree.org/schemas/power/supply/siliconmitus,sm5703-charger.yaml#
$schema: http://devicetree.org/meta-schemas/core.yaml#

title: Silicon Mitus SM5703 charger

maintainers:
  - Linux battery maintainers <linux-pm@vger.kernel.org>

description:
  The charger block of the Silicon Mitus SM5703 PMIC.  It is a child of
  the PMIC node described by siliconmitus,sm5703.yaml and shares that
  node's I2C address.

allOf:
  - $ref: power-supply.yaml#

properties:
  compatible:
    const: siliconmitus,sm5703-charger

  monitored-battery: true

  enable-gpios:
    maxItems: 1
    description:
      GPIO connected to the nCHGEN pin, which gates the charging path.
      The pin is active low in hardware, so this is normally declared
      GPIO_ACTIVE_LOW.

  input-current-limit-microamp:
    description:
      Highest current the board can carry from the charging port.  This
      is a ceiling rather than a target, so nothing raises the limit
      above it, and the charger only draws this much once something has
      identified the port as a dedicated charger.  Without an extcon
      device to do that identification the charger has nothing else to
      go on and uses this value directly, so it must then be safe for
      every source the port may see.
    minimum: 100000
    maximum: 2100000

  extcon:
    maxItems: 1
    description:
      Phandle to the MUIC that reports what kind of charging port is
      attached.  Without it the charger cannot tell a wall adapter from
      a host port.

required:
  - compatible
  - monitored-battery

additionalProperties: false

examples:
  - |
    #include <dt-bindings/gpio/gpio.h>

    charger {
        compatible = "siliconmitus,sm5703-charger";
        monitored-battery = <&battery>;
        extcon = <&muic>;
        enable-gpios = <&gpd1 3 GPIO_ACTIVE_LOW>;
        input-current-limit-microamp = <1650000>;
    };
```

## Documentation/devicetree/bindings/power/supply/siliconmitus,sm5703-fuelgauge.yaml
```yaml
# SPDX-License-Identifier: (GPL-2.0-only OR BSD-2-Clause)
%YAML 1.2
---
$id: http://devicetree.org/schemas/power/supply/siliconmitus,sm5703-fuelgauge.yaml#
$schema: http://devicetree.org/meta-schemas/core.yaml#

title: Silicon Mitus SM5703 fuel gauge

maintainers:
  - Linux battery maintainers <linux-pm@vger.kernel.org>

description: |
  The fuel gauge block of the Silicon Mitus SM5703 PMIC.  It has its own
  I2C address, usually on a different bus than the rest of the chip, and
  is independent from it.

  The chip measures the temperature of its own die, not of the cell.
  Where the pack thermistor is wired to something else, as it usually is,
  a thermal zone named "battery-thermal" is what the driver reports as
  the battery temperature.

  The gauge tracks the state of charge by following the cell voltage, so
  it needs a set of cell specific calibration tables.  Those are not
  discoverable and have to be supplied here; they are normally lifted
  from the vendor device tree of the device the cell ships in.

allOf:
  - $ref: power-supply.yaml#

properties:
  compatible:
    const: siliconmitus,sm5703-fuelgauge

  reg:
    maxItems: 1

  interrupts:
    maxItems: 1
    description: Alert interrupt, asserted on low charge or low voltage.

  monitored-battery:
    description:
      The battery being monitored.  Its operating-range-celsius, if
      given, is what the reported health is judged against.

  siliconmitus,battery-table-discharge:
    $ref: /schemas/types.yaml#/definitions/uint32-array
    minItems: 16
    maxItems: 16
    description:
      Cell voltage points of the discharge curve, in units of 1/2.048 mV.

  siliconmitus,battery-table-charge:
    $ref: /schemas/types.yaml#/definitions/uint32-array
    minItems: 16
    maxItems: 16
    description:
      Cell voltage points of the charge curve, in units of 1/2.048 mV.

  siliconmitus,battery-table-soc:
    $ref: /schemas/types.yaml#/definitions/uint32-array
    minItems: 16
    maxItems: 16
    description:
      State of charge matching each point of the two voltage tables.

  siliconmitus,rce-values:
    $ref: /schemas/types.yaml#/definitions/uint32-array
    minItems: 3
    maxItems: 3
    description: Coefficients of the resistance and capacity estimator.

  siliconmitus,dtcd-value:
    $ref: /schemas/types.yaml#/definitions/uint32
    description: Discharge time constant of the cell.

  siliconmitus,rs-values:
    $ref: /schemas/types.yaml#/definitions/uint32-array
    minItems: 4
    maxItems: 4
    description:
      Internal series resistance of the cell, followed by the mixing
      factor and the upper and lower bounds the gauge may track it to.

  siliconmitus,vit-period:
    $ref: /schemas/types.yaml#/definitions/uint32
    description: Sampling period of the voltage, current and temperature.

  siliconmitus,mix-values:
    $ref: /schemas/types.yaml#/definitions/uint32-array
    minItems: 2
    maxItems: 2
    description:
      Rate at which the voltage and coulomb counter estimates are mixed,
      and the blanking interval applied at start up.

  siliconmitus,topoff-soc:
    $ref: /schemas/types.yaml#/definitions/uint32-array
    minItems: 2
    maxItems: 2
    description:
      Whether the top off state of charge is enabled, and its level.

  siliconmitus,volt-cal:
    $ref: /schemas/types.yaml#/definitions/uint32
    description: Gain and offset calibration of the voltage measurement.

  siliconmitus,curr-cal:
    $ref: /schemas/types.yaml#/definitions/uint32
    description: Gain and offset calibration of the current measurement.

  siliconmitus,temp-std:
    $ref: /schemas/types.yaml#/definitions/uint32
    description:
      Temperature, in degrees Celsius, at which the current calibration
      above was taken.

  siliconmitus,temp-offset:
    $ref: /schemas/types.yaml#/definitions/uint32
    description:
      Temperature step, in degrees Celsius, over which one unit of
      siliconmitus,temp-offset-cal is applied.

  siliconmitus,temp-offset-cal:
    $ref: /schemas/types.yaml#/definitions/uint32
    description:
      Correction applied to the current calibration per temperature step.

  siliconmitus,charge-offset-cal:
    $ref: /schemas/types.yaml#/definitions/int32
    description:
      Correction applied to the current calibration while charging.

  siliconmitus,tem-poff:
    $ref: /schemas/types.yaml#/definitions/uint32-array
    minItems: 4
    maxItems: 4
    description:
      Cut off voltage and hysteresis, in mV, below which the gauge stops
      tracking the internal resistance and uses the calibrated value.
      The first pair applies above 15 degrees Celsius, the second below.

  siliconmitus,alert-soc-percent:
    minimum: 0
    maximum: 100
    default: 2
    description:
      State of charge below which the alert interrupt is raised.

required:
  - compatible
  - reg

dependencies:
  siliconmitus,battery-table-discharge:
    - siliconmitus,battery-table-charge
    - siliconmitus,battery-table-soc
    - siliconmitus,rce-values
    - siliconmitus,dtcd-value
    - siliconmitus,rs-values
    - siliconmitus,vit-period
    - siliconmitus,mix-values
    - siliconmitus,topoff-soc
    - siliconmitus,volt-cal
    - siliconmitus,curr-cal
    - siliconmitus,temp-std
    - siliconmitus,temp-offset
    - siliconmitus,temp-offset-cal
    - siliconmitus,charge-offset-cal
    - siliconmitus,tem-poff

additionalProperties: false

examples:
  - |
    #include <dt-bindings/interrupt-controller/irq.h>

    i2c {
        #address-cells = <1>;
        #size-cells = <0>;

        fuel-gauge@71 {
            compatible = "siliconmitus,sm5703-fuelgauge";
            reg = <0x71>;

            interrupt-parent = <&gpa0>;
            interrupts = <3 IRQ_TYPE_EDGE_FALLING>;

            monitored-battery = <&battery>;

            siliconmitus,battery-table-discharge =
                <0x1400 0x1b88 0x1ce5 0x1d35 0x1d5a 0x1d78 0x1ddd 0x1e37
                 0x1e78 0x1ed7 0x1efb 0x1f72 0x2008 0x2133 0x220c 0x2400>;
            siliconmitus,battery-table-charge =
                <0x1400 0x1b88 0x1ce5 0x1d35 0x1d5a 0x1d78 0x1ddd 0x1e37
                 0x1e78 0x1ed7 0x1efb 0x1f72 0x2008 0x2133 0x220c 0x2400>;
            siliconmitus,battery-table-soc =
                <0x0 0x81 0x1f7 0x28c 0x36d 0x658 0xaba 0x1207
                 0x1954 0x1f2b 0x20a1 0x238d 0x2964 0x31dc 0x371e 0x3749>;
            siliconmitus,rce-values = <0x0749 0x0580 0x0371>;
            siliconmitus,dtcd-value = <0x1>;
            siliconmitus,rs-values = <0x9b 0x47a 0x3800 0x00a4>;
            siliconmitus,vit-period = <0x3506>;
            siliconmitus,mix-values = <0x0503 0x0004>;
            siliconmitus,topoff-soc = <0x0 0x5>;
            siliconmitus,volt-cal = <0x809e>;
            siliconmitus,curr-cal = <0x7a85>;
            siliconmitus,temp-std = <25>;
            siliconmitus,temp-offset = <10>;
            siliconmitus,temp-offset-cal = <0x1>;
            siliconmitus,charge-offset-cal = <(-1)>;
            siliconmitus,tem-poff = <3400 50 3350 50>;
        };
    };
```
